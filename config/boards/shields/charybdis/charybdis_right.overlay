/*
 * Copyright (c) 2020 ZMK Contributors
 *
 * SPDX-License-Identifier: MIT
 */
 
#include "charybdis.dtsi"

&default_transform {
	col-offset = <7>;
};
/*
&five_column_transform {
	col-offset = <5>;
};
 */
&kscan0 {
	col-gpios
		= <&gpio0 9  (GPIO_ACTIVE_HIGH | GPIO_PULL_DOWN)>,
                <&gpio0 31 (GPIO_ACTIVE_HIGH | GPIO_PULL_DOWN)>,
                <&gpio0 29 (GPIO_ACTIVE_HIGH | GPIO_PULL_DOWN)>,
                <&gpio0 2  (GPIO_ACTIVE_HIGH | GPIO_PULL_DOWN)>,
                <&gpio1 15 (GPIO_ACTIVE_HIGH | GPIO_PULL_DOWN)>,
                <&gpio0 10  (GPIO_ACTIVE_HIGH | GPIO_PULL_DOWN)>,
                <&gpio1 1  (GPIO_ACTIVE_HIGH | GPIO_PULL_DOWN)>,
                <&gpio1 2  (GPIO_ACTIVE_HIGH | GPIO_PULL_DOWN)>,
                <&gpio1 7  (GPIO_ACTIVE_HIGH | GPIO_PULL_DOWN)>;
};















