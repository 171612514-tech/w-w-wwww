/*
 * Copyright (c) 2020 ZMK Contributors
 *
 * SPDX-License-Identifier: MIT
 */

#include "charybdis.dtsi"

&kscan0 {
	col-gpios
		 = <&gpio0 9  GPIO_ACTIVE_LOW>,
            <&gpio0 31 GPIO_ACTIVE_LOW>,
            <&gpio0 29 GPIO_ACTIVE_LOW>,
            <&gpio0 2  GPIO_ACTIVE_LOW>,
            <&gpio1 15 GPIO_ACTIVE_LOW>,
            <&gpio0 1  GPIO_ACTIVE_LOW>,
            <&gpio1 1  GPIO_ACTIVE_LOW>;
          
};



